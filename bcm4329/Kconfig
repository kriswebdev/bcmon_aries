## bcm4329/Kconfig
```kconfig
config BCM4329
	depends on MMC
	select WIRELESS_EXT
	select WEXT_PRIV
	tristate "Broadcom 4329 wireless cards support"

config BCM4329_FW_PATH
	depends on BCM4329
	string "Firmware path"
	default "/vendor/firmware/fw_bcm4329.bin"

config BCM4329_NVRAM_PATH
	depends on BCM4329
	string "NVRAM path"
	default "/vendor/firmware/nvram_net.txt"
```
